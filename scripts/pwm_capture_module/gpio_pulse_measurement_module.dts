// SPDX-License-Identifier: GPL-2.0
// https://gemini.google.com/app/19c8818984b5f80c
// SPDX-License-Identifier: GPL-2.0
// DTS for PI11 GPIO Pulse Measurement Overlay on Orange Pi Zero 2W (Allwinner H618)
// This configures PI11 as a GPIO input with interrupt capability.

#include <dt-bindings/interrupt-controller/irq.h>
#include <dt-bindings/interrupt-controller/arm-gic.h>
#include <dt-bindings/gpio/gpio.h>

/dts-v1/;
/plugin/;

/ {
    compatible = "xunlong,orangepi-zero2w", "allwinner,sun50i-h618";

    pi11_pulse_monitor {
        compatible = "tobi,pi11-pulse-monitor";
        gpios = <&pio 8 11 GPIO_ACTIVE_HIGH>; // PI11: Bank I (8), Pin 11
        status = "okay";
    };

    fragment@0 {
        target = <&pio>; // Target the main pinctrl node (pinctrl@300b000)
        __overlay__ {
            // Define pinctrl-names and pinctrl-0 properties *before* the pin group subnode.
            pinctrl-names = "default";
            pinctrl-0 = <&pi11_eint_pulse_pin>; // Reference the pin group defined below

            // Define the pin group subnode *after* the properties it contributes to.
            pi11_eint_pulse_pin: pi11_eint_pulse_pin {
                pins = "PI11";
                function = "pi_eint11"; // The EINT function for PI11
                // Add bias (pull-up/down) if your input signal might float when idle.
                // bias-disable; // or bias-pull-up;
            };
        };
    };
};