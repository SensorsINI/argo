// SPDX-License-Identifier: GPL-2.0
// DTS for Argo Radio Servo Module Overlay on Orange Pi Zero 2W (Allwinner H618)
// This overlay configures EINT input pins and explicitly defines PWM channels 2 and 4
// for control via the kernel's generic PWM API (pwm_get).

#include <dt-bindings/interrupt-controller/irq.h>
#include <dt-bindings/interrupt-controller/arm-gic.h>
#include <dt-bindings/gpio/gpio.h> // For GPIO_ACTIVE_HIGH/LOW, etc.


/dts-v1/;
/plugin/;

/ {
    compatible = "xunlong,orangepi-zero2w", "allwinner,sun50i-h618";

    // --- Fragment 0: Add the argo platform device to the root node ---
    fragment@0 {
        target-path = "/";
        __overlay__ {
            // Node for our kernel module to claim GPIOs (using compatible for lookup)
            // This node now also controls the pin multiplexing for the EINT pins.
            argo_radio_servo_gpios: argo_radio_servo_gpios {
                compatible = "argo,radio-servo-gpio";
                radio_rudder-gpios = <&pio 8 11 GPIO_ACTIVE_HIGH>; // PI11
                radio_sail-gpios = <&pio 8 13 GPIO_ACTIVE_HIGH>;   // PI13
                pwms = <&pwm 2 20000 0>, <&pwm 4 20000 0>; // PWM controller channels 2 and 4
                pwm-names = "pwm2", "pwm4"; // Labels for devm_pwm_get
                status = "okay";
            };
        };
    };

    // --- Fragment 1: Explicitly disable the Ethernet GMAC controller itself ---
    frag_emac_disable: fragment@1 {
        target = <&emac1>;
        __overlay__ {
            status = "disabled";
        };
    };

    // Fragment 2 removed - GPIO pins don't need explicit pinctrl configuration
    // when used directly as GPIOs via the gpiod subsystem

    // following commented out because we use armbian pwm output overlay instead
    // --- Fragment 3: Define PWM Output Pinmuxing Groups for PI12 and PI14 ---
    /* fragment@3 {
        target = <&pio>; // Target the main pinctrl node
        __overlay__ {
            // PI12 (PWM2_SERVO_RUDDER) - Output
            pi12_pwm2_out_group: pi12_pwm2_out_group {
                pins = "PI12";
                function = "pwm2"; // As per manual's PI12_SELECT (101:PWM2)
            };

            // PI14 (PWM4_SERVO_SAIL) - Output
            pi14_pwm4_out_group: pi14_pwm4_out_group {
                pins = "PI14";
                function = "pwm4"; // As per manual's PI14_SELECT (101:PWM4)
            };
        };
    };
    */
};
